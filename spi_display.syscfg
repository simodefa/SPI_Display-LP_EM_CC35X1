/**
 * These arguments were used when this file was generated. They will be automatically applied on subsequent loads
 * via the GUI or CLI. Run CLI with '--help' for additional information on how to override these arguments.
 * @cliArgs --board "/ti/boards/LP_EM_CC35X1" --rtos "freertos" --product "simplelink_wifi_sdk@9.22.00.15" --product "TOOLBOX@4.1.8"
 * @v2CliArgs --board "/ti/boards/LP_EM_CC35X1" --rtos "freertos" --product "simplelink_wifi_sdk@9.22.00.15" --product "TOOLBOX@4.1.8"
 * @versions {"tool":"1.27.0+4565"}
 */

/**
 * Import the modules used in this configuration.
 */
const FreeRTOS  = scripting.addModule("/freertos/FreeRTOS");
const Display   = scripting.addModule("/ti/display/Display");
const Display1  = Display.addInstance();
const GPIO      = scripting.addModule("/ti/drivers/GPIO");
const GPIO1     = GPIO.addInstance();
const GPIO2     = GPIO.addInstance();
const GPIO3     = GPIO.addInstance();
const GPIO4     = GPIO.addInstance();
const GPIO5     = GPIO.addInstance();
const GPIO6     = GPIO.addInstance();
const Power     = scripting.addModule("/ti/drivers/Power");
const SPI       = scripting.addModule("/ti/drivers/SPI");
const SPI1      = SPI.addInstance();
const Settings  = scripting.addModule("/ti/posix/freertos/Settings");
const ActionReq = scripting.addModule("/ti/vendorutils/Action/ActionReq");

/**
 * Write custom configuration values to the imported modules.
 */
Display1.$name      = "CONFIG_Display_0";
Display1.$hardware  = system.deviceData.board.components.XDS110UART;
Display1.uart.$name = "CONFIG_UART2_0";

GPIO1.$name           = "CONFIG_SPI_CONTROLLER_READY";
GPIO1.gpioPin.$assign = "boosterpack.40";

GPIO2.$name           = "CONFIG_SPI_PERIPHERAL_READY";
GPIO2.gpioPin.$assign = "boosterpack.19";

GPIO3.$name           = "CONFIG_GPIO_LCD_CS";
GPIO3.gpioPin.$assign = "boosterpack.13";

GPIO4.$name           = "CONFIG_GPIO_LCD_DC";
GPIO4.gpioPin.$assign = "boosterpack.31";

GPIO5.$name           = "CONFIG_GPIO_LCD_RST";
GPIO5.gpioPin.$assign = "boosterpack.17";

GPIO6.$name           = "CONFIG_GPIO_TRACE";
GPIO6.mode            = "Output";
GPIO6.gpioPin.$assign = "boosterpack.38";

Power.policyFunction = "PowerWFF3_doWFI";

SPI1.$name                    = "CONFIG_SPI_LCD";
SPI1.spi.sclkPin.$assign      = "boosterpack.7";
SPI1.spi.dmaRxChannel.$assign = "DMA_CH11";
SPI1.spi.dmaTxChannel.$assign = "DMA_CH10";
SPI1.spi.picoPin.$assign      = "boosterpack.15";

ActionReq.ota             = true;
ActionReq.activation_type = "authentication_bypass";
ActionReq.boot_sector     = false;
ActionReq.primary_tbl     = false;
ActionReq.primary_ti_wsoc = false;

/**
 * Pinmux solution for unlocked pins/peripherals. This ensures that minor changes to the automatic solver in a future
 * version of the tool will not impact the pinmux you originally saw.  These lines can be completely deleted in order to
 * re-solve from scratch.
 */
Display1.uart.uart.$suggestSolution              = "UART1";
Display1.uart.uart.dmaTxChannel.$suggestSolution = "DMA_CH1";
Display1.uart.uart.dmaRxChannel.$suggestSolution = "DMA_CH0";
Display1.uart.uart.txPin.$suggestSolution        = "GPIO5";
SPI1.spi.$suggestSolution                        = "SPI0";
SPI1.spi.pociPin.$suggestSolution                = "boosterpack.3";
